//Пример программы. Связь с компьютером по USART.
//Светодиоды на линиях №18, 19, подключены к VCC.
//Переменная для приёма данных. Тип byte, имя x.
byte x;
void setup() {
//Устанавливаем линии светодиодов на выход
pinMode(18, OUTPUT);
pinMode(19, OUTPUT);
//Тушим светодиоды (подачей напряжения).
digitalWrite(18, HIGH);
digitalWrite(19, HIGH);
Serial.begin(19200);
Serial.print("Hello, World!!");
}
void loop() {
//Принимаем очередную команду от ПК.
x = Serial.read();
//Обрабатываем её:
if(x=='1') {
//Если 1 - зажигаем светодиод 1 (снятием напряжения).
digitalWrite(18, LOW);
}
if(x=='2') {
//Если 2 - зажигаем светодиод 2 (снятием напряжения).
digitalWrite(19, LOW);
}
if(x=='4') {
//Если 4 - тушим светодиод 1 (подачей напряжения).
digitalWrite(18, HIGH);
}
if(x=='5') {
//Если 5 - тушим светодиод 2 (подачей напряжения).
digitalWrite(19, HIGH);
}
if(x=='0') {
//Если 0 - здержка 250 мс.
delay(250);
}
if(x=='+') {
//Если + - отвечаем компьютеру.
Serial.print("Sakura ");
}
//И продолжаем, пока есть напряжение. ^__^
}
